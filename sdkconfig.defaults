## sdkconfig.defaults
```kconfig
# ESP32-S3 摄像头实时画面
CONFIG_ESP_DEFAULT_CPU_FREQ_MHZ_240=y
CONFIG_COMPILER_OPTIMIZATION_PERF=y

# PSRAM：S3-EYE / WROOM-1 N8R8 均为 Octal 8MB
CONFIG_SPIRAM=y
CONFIG_SPIRAM_MODE_OCT=y
CONFIG_SPIRAM_SPEED_80M=y
CONFIG_SPIRAM_USE_MALLOC=y

# 控制台走内置 USB Serial/JTAG
CONFIG_ESP_CONSOLE_USB_SERIAL_JTAG=y

# 关掉无关日志
CONFIG_LOG_DEFAULT_LEVEL_WARN=y
```
